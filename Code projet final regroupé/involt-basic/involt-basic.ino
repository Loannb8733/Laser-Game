// ---------- Loann BDR ----------

#include <SeeedOLED.h>

int    involtPin[14] = {}; //equals involt.pin.P in app
String involtString[2] ={}; //equals involt.pin.S in app
char involt[16];

String fname;

#include <Wire.h>
unsigned long debut;
unsigned long rebours;
unsigned long dureepartie;
unsigned long dureepause = 0;
unsigned long debutpause =0;

int minut ;
int seconde ;

#define bp 7
int compte = 0;
bool appui = 0;
#define bp2 3
int compte2 = 0;
bool appui2 = 0;
int compte3 = 100;
bool appui3 = 0;
int compte4 = 100;
bool appui4 = 0;
bool depart = 0;
bool pause = 0;
bool reprendrepartie = 0;

// ---------- Loann BDR ----------

// ------- Loann BST ------
#include <avr/pgmspace.h>
static const unsigned char batterie[]PROGMEM ={


0xFF,0xFF,0x01,0x01,0x01,0x01,0x01,0xC1,0xC1,0xC1,0xC1,0xC1,0xC1,0xC1,0xC1,0xC1,
0xC1,0xC1,0xC1,0xC1,0xC1,0xC1,0xC1,0xC1,0xC1,0xC1,0xC1,0xC1,0xC1,0xC1,0xC1,0xC1,
0xC1,0xC1,0xC1,0xC1,0xC1,0xC1,0xC1,0xC1,0xC1,0xC1,0xC1,0xC1,0xC1,0xC1,0xC1,0xC1,
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0x80,0xFF,0xFF,0xFF,0xFF,0xFF,0xFF,0xFF,0xFF,0xFF,0xFF,0xFF,0xFF,0xFF,0xFF,0xFF
};
static const unsigned char batterie1[]PROGMEM ={

0xFF,0xFF,0x01,0x01,0x01,0x01,0x01,0xC1,0xC1,0xC1,0xC1,0xC1,0xC1,0xC1,0xC1,0xC1,
0xC1,0xC1,0xC1,0xC1,0xC1,0xC1,0xC1,0xC1,0xC1,0xC1,0xC1,0xC1,0xC1,0xC1,0xC1,0xC1,
0xC1,0xC1,0xC1,0xC1,0xC1,0xC1,0xC1,0xC1,0xC1,0xC1,0xC1,0xC1,0xC1,0xC1,0xC1,0xC1,
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0x80,0xFF,0xFF,0xFF,0xFF,0xFF,0xFF,0xFF,0xFF,0xFF,0xFF,0xFF,0xFF,0xFF,0xFF,0xFF
};

static const unsigned char batterie2[]PROGMEM ={

0xFF,0xFF,0x01,0x01,0x01,0x01,0x01,0xC1,0xC1,0xC1,0xC1,0xC1,0xC1,0xC1,0xC1,0xC1,
0xC1,0xC1,0xC1,0xC1,0xC1,0xC1,0xC1,0xC1,0xC1,0xC1,0xC1,0xC1,0xC1,0xC1,0xC1,0xC1,
0xC1,0xC1,0xC1,0xC1,0xC1,0xC1,0xC1,0xC1,0xC1,0xC1,0xC1,0xC1,0xC1,0xC1,0xC1,0xC1,
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0x80,0xFF,0xFF,0xFF,0xFF,0xFF,0xFF,0xFF,0xFF,0xFF,0xFF,0xFF,0xFF,0xFF,0xFF,0xFF
};

static const unsigned char batterie3[]PROGMEM ={
  
0xFF,0xFF,0x01,0x01,0x01,0x01,0x01,0xC1,0xC1,0xC1,0xC1,0xC1,0xC1,0xC1,0xC1,0xC1,
0xC1,0xC1,0xC1,0xC1,0xC1,0xC1,0xC1,0xC1,0xC1,0xC1,0xC1,0xC1,0xC1,0xC1,0xC1,0xC1,
0xC1,0xC1,0xC1,0xC1,0xC1,0xC1,0xC1,0xC1,0xC1,0xC1,0xC1,0xC1,0xC1,0xC1,0xC1,0xC1,
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0x80,0xFF,0xFF,0xFF,0xFF,0xFF,0xFF,0xFF,0xFF,0xFF,0xFF,0xFF,0xFF,0xFF,0xFF,0xFF
};

static const unsigned char batterie4[]PROGMEM ={
  
0xFF,0xFF,0x01,0x01,0x01,0x01,0x01,0xC1,0xC1,0xC1,0xC1,0xC1,0xC1,0xC1,0xC1,0xC1,
0xC1,0xC1,0xC1,0xC1,0xC1,0xC1,0xC1,0xC1,0xC1,0xC1,0xC1,0xC1,0xC1,0xC1,0xC1,0xC1,
0xC1,0xC1,0xC1,0xC1,0xC1,0xC1,0xC1,0xC1,0xC1,0xC1,0xC1,0xC1,0xC1,0xC1,0xC1,0xC1,
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0x80,0xFF,0xFF,0xFF,0xFF,0xFF,0xFF,0xFF,0xFF,0xFF,0xFF,0xFF,0xFF,0xFF,0xFF,0xFF
};

unsigned long debut;
unsigned long rebours;
unsigned long dureepartie;
unsigned long etatbatterie;

int minute ;
int seconde ;
int tension ;

// ------ Loann BST -------

// ------ Kevin --------

#include <Adafruit_NeoPixel.h>// bibliothèque des LED RGB
#ifdef __AVR__
  #include <avr/power.h>
#endif
#include <IRremote.h> // Bibliothèque télécommande infra rouge
#define DEL_IR 3 // La diode d'émission infra rouge est branchée sur la broche 3
#define gachette 4 // Le bouton simulant la gachette est branché sur la broche 4
  #define PIN  8// les LED RGB sont branché sur la broche 8
  
bool boolBouton = 0 ; // Variable bouléenne permettant d'éviter les tirs en cascade

 int RECV_PIN = 2; // Le recepteur >Infra rouge est branché sur la broche 2 ;

 
//int codeType;
int codeLen; // déclare la variable codeLen
int joueur1touche = 0 ;//déclare la variable joueur 1 touche 
float attendre ; //déclare la variable attendre
int seconde ;//déclare la variable seconde
int minute ; //déclare la variable minute
int tension ;//déclare la variable tension

const int mv = 6;//déclare la variable moteur vibrant 



// pour envoyer sur l'ir PIN 3
IRsend lasergun1; // Création d'un objet lasergun1 qui envoie des données via la diode laser

IRrecv plastron1 (RECV_PIN); // Création d'un objet plastron1 qui recoit des données
 
decode_results results; // Les résultats de la réception iront dans la variable "results"
 
char joueur1[] = "BOUBOU"; //déclare la variable joueur 1 écrit " Boulo"

int delayval = 500; //déclare la variable attendre la valeur 
uint8_t colorOrder = 0x52; //déclare la variable ordre de couleur donne la valeur hadécimale 52
int numPixel = 20; //déclare la variable numéro de pixel donne la valeur 20
Adafruit_NeoPixel *pixels;

// ------- Kevin -------

void setup() 

// ---------- Loann BDR ----------

{
 Serial.begin(57600);
 Wire.begin();
 SeeedOled.init();  //initialze SEEED OLED display

 SeeedOled.clearDisplay();          //clear the screen and set start position to top left corner
 SeeedOled.setNormalDisplay();      //Set display to normal mode (i.e non-inverse mode)
 SeeedOled.setPageMode();           //Set addressing mode to Page Mode
 SeeedOled.setTextXY(0,0);          //Set the cursor to Xth Page, Yth Column  
 SeeedOled.putString("BOUBOU"); //Print the String
 SeeedOled.setTextXY(1,0);
 SeeedOled.putString("BUBU");
 SeeedOled.setTextXY(3,0);
 SeeedOled.putString("compte a rebours");
  delay(1000);
   debut = millis ();
pinMode (5, OUTPUT);

// ---------- Loann BDR ----------
  
// ---------- Loann BST ---------- 
  SeeedOled.clearDisplay();   
  SeeedOled.setTextXY(0,0); 
   tension = ((analogRead (A0)*5)/1023); // Lire la tension sur A0
  switch (tension){
    case 0:
    SeeedOled.drawBitmap((unsigned char*)batterie,1024);  //1024 = 128 Pixels * 64 Pixels / 8
    break;
    case 1:
    SeeedOled.drawBitmap((unsigned char*)batterie1,1024);  //1024 = 128 Pixels * 64 Pixels / 8
    break;
    case 2:
    SeeedOled.drawBitmap((unsigned char*)batterie2,1024);  //1024 = 128 Pixels * 64 Pixels / 8
    break;
    case 3:
    SeeedOled.drawBitmap((unsigned char*)batterie3,1024);  //1024 = 128 Pixels * 64 Pixels / 8
    break;
    case 4:
    SeeedOled.drawBitmap((unsigned char*)batterie4,1024);  //1024 = 128 Pixels * 64 Pixels / 8
    break;
  }
    delay (3000);
    
  SeeedOled.clearDisplay();   
  SeeedOled.setTextXY(0,0);

// ---------- Loann BST ----------

// ------- kevin ----------

pinMode (6,OUTPUT); // broche 6 (sortie)
pinMode (7,INPUT);  // broche 7 (entrée)
pinMode (4,INPUT); // broche 4 (entrée)
pinMode(PIN, OUTPUT); //broche PIN (sortie)



  Serial.begin(57600); // Mise enroute de la communication série
  plastron1.enableIRIn(); // Commencement de la reception du plastron 1
 
  
Wire.begin();
  SeeedOled.init();  //initialze SEEED OLED display

  SeeedOled.clearDisplay();          //effacer l’écran et régler la position de départ dans le coin supérieur gauche
  SeeedOled.setNormalDisplay();      //Régler l’affichage en mode normal ( mode non inverse)
  SeeedOled.setPageMode();           //Définir le mode d’adressage en Mode Page

    #if defined (__AVR_ATtiny85__) // si définie AVR_ATtiny85 
  if (F_CPU == 16000000) clock_prescale_set(clock_div_1); // si 
#endif
  pixels = new Adafruit_NeoPixel(numPixel, PIN, colorOrder); // 
  pixels->setBrightness(255); //
  pixels->begin(); // This initializes the NeoPixel library. 

  for(int i=0;i<numPixel;i++){

    pixels->setPixelColor(i, pixels->Color(0,255,0)); // Moderately bright green color.
   
    
    
    pixels->show(); // animation des LED RGB en début de partie  

    delay(delayval); // attendre 0,5 secondes

  }

  // ------ kevin --------
}



void loop() {
      
 // ----- loann BDR ------
 
      involtReceive();
        
        depart = involtPin[5]; //la variable depart est égale au bouton P5 chez HTML
        if (depart == 0) // si depart est egal à 0
        {
      do //lancer le compte à rebours
      {
        involtReceive();
        depart = involtPin[5]; 
        debut = millis ();
        digitalWrite (5, LOW); // la led comprise sur la broche D5 est éteinte
        
      } while (depart != HIGH); // tant que depart ne soit pas ré appuyer alors laisser le compte à rebours 
        }
      digitalWrite (5, HIGH); // allumer la LED comprise sur la broche 5
   

   ///////////////////////////
  /// COMPTAGE DES POINTS ///
 ///////////////////////////
 
  if (digitalRead(bp) == HIGH && appui == 0)
    {
      compte ++;
      appui  = 1;
    }
   else if (digitalRead(bp) == LOW && appui == 1)
    {
      appui = 0;
    }
   Serial.println (compte);
   involtSend(0, compte);
      
  if (compte > 100)
    {
      compte = 0;
    }

   if (digitalRead(bp2) == HIGH && appui2 == 0)
    {
      compte2 ++;
      appui2  = 1;
    }
   else if (digitalRead(bp2) == LOW && appui2 == 1)
    {
      appui2 = 0;
    }
   Serial.println (compte2);
   involtSend(1, compte2);

   if (compte2 > 100)
    {
      compte2 = 0;
    }

   if (digitalRead(bp) == HIGH && appui3 == 0)
      {
        compte3 --;
        appui3 = 1;
      }

    else if (digitalRead(bp) == LOW && appui3 == 1)
      {
        appui3 = 0;
      }
    Serial.println (compte3);
    involtSend(2, compte3);
    
    if (compte3 < 0)
      {
        compte3 = 100;
      }

    if (digitalRead(bp2) == HIGH && appui4 == 0)
      {
        compte4 --;
        appui4 = 1;
      }

    else if (digitalRead(bp2) == LOW && appui4 == 1)
      {
        appui4 = 0;
      }
    Serial.println (compte4);
    involtSend(3, compte4);
    
    if (compte4 < 0)
      {
        compte4 = 100;
      }


        
     
// Début du chronomètre

 dureepartie = ( millis() - debut  )/1000; // la variable dureepartie prend la valeur (millis - debut)/1000
        
        involtReceive();
        pause = involtPin[9]; //la variable depart est égale au bouton P9 chez HTML
        
       if (pause == HIGH ) // Si pause est égale à 1
        {
         debutpause = millis(); // debutpause est égal à millis
        
         do //faire
        {
         involtReceive();
         pause = involtPin[9];
         dureepause = millis() - debutpause ; //dureepause est égale millis - debutpause
        }while (pause != LOW); // tant que pause est différent 0
        debut = debut + dureepause; // alors debut est egal à la variable debut + duree pause
        }
 
 rebours = 600 - dureepartie  ;

 
 if(rebours > 1000) // si rebours est superieur à 100
  {
    rebours = 0; // alors rebours = 0
  }

 minut = rebours / 60 ; // Calcul de minute
 seconde = rebours % 60 ; // Le nombre de seconde est le reste de la division %
  /*
  SeeedOled.setTextXY(5,0);
  SeeedOled.putNumber(minute);
   SeeedOled.putString(" : ");
   SeeedOled.putNumber(seconde);
   */
  /* if (rebours == 0) 
    {
      dureepartie = 0;
    }
    */      


          involtSend(4,minut);
          involtSend(5,seconde);
          involtSend(6,rebours);
 


  
  //Clear the function to trigger it only once.
  fname = "";

        


       //reprendrepartie = involtPin[4]; //la variable depart est égale au bouton P5 chez HTML
        //if (reprendrepartie == 1) // si depart est egale à 0
       
// ----------- Loann BDR -------- 

 //_ _ _ _ _ _ _ _ _ _ _ _ _ _ _ _ _ _ _ __ _ _ _ _ _ _ _ _ _ _ _ _ _ _ _ _ _ _ _ _
                              //PARTIE EMISSION//
 //_ _ _ _ _ _ _ _ _ _ _ _ _ _ _ _ _ _ _ __ _ _ _ _ _ _ _ _ _ _ _ _ _ _ _ _ _ _ _ _ _

  


 
 if(digitalRead(gachette)== HIGH && boolBouton == 0) // Si appui sur le BP 
      {
          SeeedOled.setTextXY(1,0);        // définit la ligne et la colonne sur l'écran LCD  
          SeeedOled.putString("Tir laser 1"); //écrit "tir laser 1" quand on tir
          // Code decimal,Type,Bits
          lasergun1.sendSony(4000,16); //void sendSony(unsigned long data, int nbits);Envoi du code 4000 sur 16 bits 
          delay(20); // attendre 20 millisecondes
          boolBouton = 1 ; // bouton reçoit 1
          plastron1.enableIRIn();// Remise en route la réception
           digitalWrite(mv,digitalRead (gachette)); // dit au moteur vibrant de lire la gachette 
     }      else  if (digitalRead(gachette)== (HIGH))// sinon lit la gachette allumée 
              {
                  boolBouton = 0 ;// bouton reçoit 0
              }
    
   // results.value = 0 ; // la valeur a pour résultat 0

 //_ _ _ _ _ _ _ _ _ _ _ _ _ _ _ _ _ _ _ __ _ _ _ _ _ _ _ _ _ _ _ _ _ _ _ _ _ _ _ _ _ 
                                      // PARTIE RECEPTION
 //_ _ _ _ _ _ _ _ _ _ _ _ _ _ _ _ _ _ _ __ _ _ _ _ _ _ _ _ _ _ _ _ _ _ _ _ _ _ _ _ _ 



         
                                   
   if (plastron1.decode(&results)) // Si le plastron reçoit des données alors
   {
      Serial.println(results.value, DEC); // Ecrtiure des données recues en décimal sur le moniteur série (TEST et Vérification)
      plastron1.resume(); // Commande permettant la Réception de la prochaine valeur 
   
 
      if(results.value == 2000 ) // Si le code reçu est 2000 alors
          {
                 
              
              
               SeeedOled.setHorizontalMode();   // définit le mode horizontale         
              SeeedOled.setTextXY(2,0);           // définit la ligne et la colonne sur l'écran LCD 
              SeeedOled.putString("Pl 1 touché: ");// écrit "Pl 1 touché" quand joueur est touché
              joueur1touche = joueur1touche + 1;// mise à jour du score
              SeeedOled.putNumber(joueur1touche);// Ecriture du score sur le moniteur série
              SeeedOled.putString(" fois.");// écrit "fois" après "pl 1 touché"
               
               
                             
             // ETEINDRE LE PLASTRON
             pixels->setPixelColor(0, pixels->Color(0,0,0));//éteint les LED RGB (0,0,0=pas de couleur)
              pixels->show();// animation des LED RGB 
              pixels->setPixelColor(1, pixels->Color(0,0,0)); //éteint les LED RGB (0,0,0=pas de couleur)
              pixels->show(); // animation des LED RGB 
              pixels->setPixelColor(2, pixels->Color(0,0,0)); //éteint les LED RGB (0,0,0=pas de couleur)
              pixels->show(); // animation des LED RGB 
              pixels->setPixelColor(3, pixels->Color(0,0,0)); //éteint les LED RGB (0,0,0=pas de couleur)
              pixels->show(); // animation des LED RGB 
              pixels->setPixelColor(4, pixels->Color(0,0,0)); //éteint les LED RGB (0,0,0=pas de couleur)
              pixels->show(); // animation des LED RGB 
              pixels->setPixelColor(5, pixels->Color(0,0,0)); //éteint les LED RGB (0,0,0=pas de couleur)
              pixels->show(); // animation des LED RGB 
              pixels->setPixelColor(6, pixels->Color(0,0,0)); //éteint les LED RGB (0,0,0=pas de couleur)
              pixels->show(); // animation des LED RGB 
              pixels->setPixelColor(7, pixels->Color(0,0,0)); //éteint les LED RGB (0,0,0=pas de couleur)
              pixels->show(); // animation des LED RGB 
              pixels->setPixelColor(8, pixels->Color(0,0,0)); //éteint les LED RGB (0,0,0=pas de couleur)
              pixels->show(); // animation des LED RGB 
              pixels->setPixelColor(9, pixels->Color(0,0,0)); //éteint les LED RGB (0,0,0=pas de couleur)
              pixels->show(); // animation des LED RGB 
              pixels->setPixelColor(10, pixels->Color(0,0,0)); //éteint les LED RGB (0,0,0=pas de couleur)
              pixels->show(); // animation des LED RGB 
              pixels->setPixelColor(11, pixels->Color(0,0,0));//éteint les LED RGB (0,0,0=pas de couleur)
              pixels->show(); // animation des LED RGB 
              pixels->setPixelColor(12, pixels->Color(0,0,0)); //éteint les LED RGB (0,0,0=pas de couleur)
              pixels->show(); // animation des LED RGB 
              pixels->setPixelColor(13, pixels->Color(0,0,0)); //éteint les LED RGB (0,0,0=pas de couleur)
              pixels->show(); // animation des LED RGB 
              pixels->setPixelColor(14, pixels->Color(0,0,0)); //éteint les LED RGB (0,0,0=pas de couleur)
              pixels->show(); // animation des LED RGB 
              pixels->setPixelColor(15, pixels->Color(0,0,0)); //éteint les LED RGB (0,0,0=pas de couleur)
              pixels->show(); // animation des LED RGB 
              pixels->setPixelColor(16, pixels->Color(0,0,0)); //éteint les LED RGB (0,0,0=pas de couleur)
              pixels->show(); // animation des LED RGB 
              pixels->setPixelColor(17, pixels->Color(0,0,0)); //éteint les LED RGB (0,0,0=pas de couleur)
              pixels->show(); // animation des LED RGB 
              pixels->setPixelColor(18, pixels->Color(0,0,0)); //éteint les LED RGB (0,0,0=pas de couleur)
              pixels->show(); // animation des LED RGB 
              pixels->setPixelColor(19, pixels->Color(0,0,0)); //éteint les LED RGB (0,0,0=pas de couleur)
              pixels->show(); // animation des LED RGB 
              pixels->setPixelColor(20, pixels->Color(0,0,0));//éteint les LED RGB (0,0,0=pas de couleur)
              pixels->show();// animation des LED RGB 
               
        digitalWrite(mv,HIGH);//allume le moteur vibrant
              delay(500);//attendre 0.5 seconde 
              digitalWrite(mv,LOW);//éteindre le moteur vibrant
              delay(250);//attendre 0.25 seconde
              digitalWrite(mv,HIGH);//allume le moteur vibrant
             delay(500);//attendre 0.5 seconde 
             digitalWrite(mv,LOW);//éteindre le moteur vibrant
          
                  
   SeeedOled.putString("compte a rebours");//écrit "compte a rebours" sur l'écran LCD
   debutpause = millis (); // début pause égal millisecondes

              
          }
  
  while ( (millis() - debutpause) < 10000) // quand millisecondes moins début pause inférieur à 10 000
  
  {
  
   // la variable attendre de type entière recoit  ( 10 - le temps restant)
  //afficher l'écran LCD la variable attendre
   attendre  = 9 - ((millis() - debutpause)/1000);// attendre égal à 9 moins millisecondes moins début pause diviser 1000 
  SeeedOled.setInverseDisplay();   //inverse le compte a rebour (de 10 a 0)  
  

   SeeedOled.setTextXY(5,2);//définie la ligne et la colone du texte sur l'écran LCD
   SeeedOled.putString(" ");//écrit le nombre de temps qu'il reste du compte a rebours

   SeeedOled.setTextXY(5,1);//définie la ligne et la colone du texte sur l'écran LCD
  SeeedOled.putNumber(attendre);//écriture du compte a rebours sur le moniteur série
   
 }
  
  
  
  SeeedOled.setNormalDisplay(); //met le lecteur LCD en mode normale   
   // RALLUMER LE PLASTRON
              pixels->setPixelColor(0, pixels->Color(0,255,0));//allume les LED RGB (0,255,0=couleur vert)
              pixels->show();// animation des LED RGB 
              pixels->setPixelColor(1, pixels->Color(0,255,0)); //allume les LED RGB (0,255,0=couleur vert)
              pixels->show(); // animation des LED RGB 
              pixels->setPixelColor(2, pixels->Color(0,255,0)); //allume les LED RGB (0,255,0=couleur vert)
              pixels->show(); // animation des LED RGB 
              pixels->setPixelColor(3, pixels->Color(0,255,0)); //allume les LED RGB (0,255,0=couleur vert)
              pixels->show(); // animation des LED RGB 
              pixels->setPixelColor(4, pixels->Color(0,255,0)); //allume les LED RGB (0,255,0=couleur vert)
              pixels->show(); // animation des LED RGB 
              pixels->setPixelColor(5, pixels->Color(0,255,0)); //allume les LED RGB (0,255,0=couleur vert)
              pixels->show(); // animation des LED RGB v
              pixels->setPixelColor(6, pixels->Color(0,255,0)); //allume les LED RGB (0,255,0=couleur vert)
              pixels->show(); // animation des LED RGB 
              pixels->setPixelColor(7, pixels->Color(0,255,0));//allume les LED RGB (0,255,0=couleur vert)
              pixels->show(); // animation des LED RGB 
              pixels->setPixelColor(8, pixels->Color(0,255,0)); //allume les LED RGB (0,255,0=couleur vert)
              pixels->show(); // animation des LED RGB 
              pixels->setPixelColor(9, pixels->Color(0,255,0)); //allume les LED RGB (0,255,0=couleur vert)
              pixels->show(); // animation des LED RGB 
              pixels->setPixelColor(10, pixels->Color(0,255,0)); //allume les LED RGB (0,255,0=couleur vert)
              pixels->show(); // animation des LED RGB 
              pixels->setPixelColor(11, pixels->Color(0,255,0)); //allume les LED RGB (0,255,0=couleur vert)
              pixels->show(); // animation des LED RGB 
              pixels->setPixelColor(12, pixels->Color(0,255,0)); //allume les LED RGB (0,255,0=couleur vert)
              pixels->show(); // animation des LED RGB 
              pixels->setPixelColor(13, pixels->Color(0,255,0)); //allume les LED RGB (0,255,0=couleur vert)
              pixels->show(); // animation des LED RGB 
              pixels->setPixelColor(14, pixels->Color(0,255,0)); //allume les LED RGB (0,255,0=couleur vert)
              pixels->show(); // animation des LED RGB 
              pixels->setPixelColor(15, pixels->Color(0,255,0)); //allume les LED RGB (0,255,0=couleur vert)
              pixels->show(); // animation des LED RGB 
              pixels->setPixelColor(16, pixels->Color(0,255,0)); //allume les LED RGB (0,255,0=couleur vert)
              pixels->show(); // animation des LED RGB 
              pixels->setPixelColor(17, pixels->Color(0,255,0)); //allume les LED RGB (0,255,0=couleur vert)
              pixels->show(); // animation des LED RGB 
              pixels->setPixelColor(18, pixels->Color(0,255,0)); //allume les LED RGB (0,255,0=couleur vert)
              pixels->show(); // animation des LED RGB 
              pixels->setPixelColor(19, pixels->Color(0,255,0)); //allume les LED RGB (0,255,0=couleur vert)
              pixels->show(); // animation des LED RGB 
              pixels->setPixelColor(20, pixels->Color(0,255,0)); //allume les LED RGB (0,255,0=couleur vert)
              pixels->show(); // animation des LED RGB 
              
  
              }
}



/*
  INVOLT FUNCTIONS
  ------------------------------------------------------

  involtReceive
  ------------------------------------------------------ 
  read the data from app and parse the values received 
  into proper array. The read until is used due to
  issues with missing chars when reading direct strings.
  
  involtSend, involtSendString
  ------------------------------------------------------
  send int or string to app. Multiple prints are to
  reduce the sketch size (compared to sprintf()).

  involtSendFunction
  ------------------------------------------------------
  send function name to trigger it in app.
*/

void involtReceive(){
  if(Serial.available()>0) {
    Serial.readBytesUntil('\n',involt,sizeof(involt));
    int pin;
    if (involt[0] == 'P'){
      int value;
      sscanf(involt, "P%dV%d", &pin, &value);
      involtPin[pin] = value;
    }
    else if (involt[0] == 'S'){
      char value[sizeof(involt)];
      sscanf(involt, "S%dV%s", &pin, &value);
      involtString[pin] = value;
    }
    else if (involt[0] == 'F'){
      char value[sizeof(involt)];
      sscanf(involt, "F%s", &value);
      fname = value;
    };
    memset(involt,0,sizeof(involt));
  };
};

void involtSend(int pinNumber, int sendValue){
  Serial.print('A'); 
  Serial.print(pinNumber); 
  Serial.print('V'); 
  Serial.print(sendValue); 
  Serial.println('E');
  Serial.flush();
};

void involtSendString(int pinNumber, String sendString){
  Serial.print('A'); 
  Serial.print(pinNumber); 
  Serial.print('V'); 
  Serial.print(sendString); 
  Serial.println('E'); 
  Serial.flush();

};

void involtSendFunction(String functionName){
  Serial.print('F'); 
  Serial.print(functionName); 
  Serial.println('E'); 
  Serial.flush();
};
